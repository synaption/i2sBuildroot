## i2s_mic/configs/coral_defconfig
```kconfig
BR2_aarch64=y
BR2_ARM_FPU_VFPV3=y
BR2_TOOLCHAIN_BUILDROOT_GLIBC=y
BR2_TOOLCHAIN_BUILDROOT_CXX=y
BR2_GCC_ENABLE_LTO=y
BR2_TARGET_GENERIC_HOSTNAME="i2s"
BR2_TARGET_GENERIC_ISSUE="Welcome to i2s"
BR2_INIT_SYSTEMD=y
# BR2_TARGET_ENABLE_ROOT_LOGIN is not set
BR2_TARGET_GENERIC_REMOUNT_ROOTFS_RW=y
BR2_SYSTEM_DHCP=""
BR2_SYSTEM_DEFAULT_PATH="/bin:/sbin:/usr/bin:/usr/sbin"

BR2_PACKAGE_HOST_LINUX_HEADERS_CUSTOM_6_2=y
BR2_TARGET_GENERIC_GETTY_PORT="ttymxc0"
BR2_ROOTFS_POST_BUILD_SCRIPT="$(BR2_EXTERNAL_BR2RAUC_PATH)/board/coral/post-build.sh"
BR2_ROOTFS_POST_IMAGE_SCRIPT="$(BR2_EXTERNAL_BR2RAUC_PATH)/board/coral/imx8-bootloader-prepare.sh $(BR2_EXTERNAL_BR2RAUC_PATH)/board/coral/post-image.sh"
BR2_ROOTFS_POST_SCRIPT_ARGS="${UBOOT_DIR}/arch/arm/dts/imx8mq-phanbell.dtb"
BR2_LINUX_KERNEL=y
BR2_LINUX_KERNEL_CUSTOM_GIT=y
BR2_LINUX_KERNEL_CUSTOM_REPO_URL="https://github.com/nxp-imx/linux-imx"
BR2_LINUX_KERNEL_CUSTOM_REPO_VERSION="lf-6.1.36-2.1.0"
BR2_LINUX_KERNEL_CUSTOM_REPO_VERSION="lf-6.6.y"
BR2_LINUX_KERNEL_DEFCONFIG="imx_v8"
BR2_LINUX_KERNEL_DTS_SUPPORT=y
BR2_LINUX_KERNEL_INTREE_DTS_NAME="freescale/imx8mq-phanbell"
BR2_LINUX_KERNEL_NEEDS_HOST_OPENSSL=y
BR2_PACKAGE_FREESCALE_IMX=y
BR2_PACKAGE_FREESCALE_IMX_PLATFORM_IMX8M=y
BR2_PACKAGE_FIRMWARE_IMX=y
BR2_TARGET_ROOTFS_EXT2=y
BR2_TARGET_ROOTFS_EXT2_4=y
BR2_TARGET_ROOTFS_EXT2_SIZE="1000M"
BR2_TARGET_ARM_TRUSTED_FIRMWARE=y
BR2_TARGET_ARM_TRUSTED_FIRMWARE_CUSTOM_GIT=y
BR2_TARGET_ARM_TRUSTED_FIRMWARE_CUSTOM_REPO_URL="https://github.com/nxp-imx/imx-atf"
BR2_TARGET_ARM_TRUSTED_FIRMWARE_CUSTOM_REPO_VERSION="lf-6.1.36-2.1.0"
BR2_TARGET_ARM_TRUSTED_FIRMWARE_PLATFORM="imx8mq"
BR2_TARGET_ARM_TRUSTED_FIRMWARE_BL31=y
BR2_TARGET_UBOOT=y
BR2_TARGET_UBOOT_BUILD_SYSTEM_KCONFIG=y
BR2_TARGET_UBOOT_CUSTOM_VERSION=y
BR2_TARGET_UBOOT_CUSTOM_VERSION_VALUE="2022.07"
BR2_TARGET_UBOOT_BOARD_DEFCONFIG="imx8mq_phanbell"
BR2_TARGET_UBOOT_NEEDS_DTC=y
BR2_TARGET_UBOOT_FORMAT_CUSTOM=y
BR2_TARGET_UBOOT_FORMAT_CUSTOM_NAME="u-boot-nodtb.bin"
BR2_TARGET_UBOOT_SPL=y
BR2_PACKAGE_HOST_DOSFSTOOLS=y
BR2_PACKAGE_HOST_GENIMAGE=y
BR2_PACKAGE_HOST_IMX_MKIMAGE=y
BR2_PACKAGE_HOST_MTOOLS=y
BR2_PACKAGE_HOST_UBOOT_TOOLS=y
BR2_PACKAGE_HOST_UBOOT_TOOLS_FIT_SUPPORT=y

BR2_ROOTFS_OVERLAY="$(BR2_EXTERNAL_BR2RAUC_PATH)/board/coral/rootfs-overlay $(BR2_EXTERNAL_I2S_MIC_PATH)/rootfs-overlay"
BR2_LINUX_KERNEL_CONFIG_FRAGMENT_FILES="$(BR2_EXTERNAL_BR2RAUC_PATH)/linux.fragment"
BR2_TARGET_UBOOT_CONFIG_FRAGMENT_FILES="$(BR2_EXTERNAL_BR2RAUC_PATH)/board/coral/u-boot.fragment"
BR2_PACKAGE_BUSYBOX_CONFIG_FRAGMENT_FILES="$(BR2_EXTERNAL_BR2RAUC_PATH)/board/coral/busybox.fragment"
BR2_GLOBAL_PATCH_DIR="$(BR2_EXTERNAL_BR2RAUC_PATH)/patches"

BR2_PACKAGE_HOST_RAUC=y
BR2_PACKAGE_RAUC=y
BR2_PACKAGE_RAUC_DBUS=y
BR2_PACKAGE_RAUC_NETWORK=y
BR2_PACKAGE_RAUC_JSON=y
BR2_PACKAGE_UTIL_LINUX_WDCTL=y

BR2_CCACHE=y
BR2_CCACHE_INITIAL_SETUP=""
BR2_CCACHE_USE_BASEDIR=y
BR2_CCACHE_DIR="$(HOME)/cache/cc" 
BR2_DL_DIR="$(HOME)/cache/dl"

BR2_TOOLCHAIN=y
BR2_TOOLCHAIN_USES_GLIBC=y
# BR2_TOOLCHAIN_BUILDROOT is not set
BR2_TOOLCHAIN_EXTERNAL=y
# BR2_TOOLCHAIN_EXTERNAL_ARM_AARCH64 is not set
# BR2_TOOLCHAIN_EXTERNAL_LINARO_AARCH64 is not set
BR2_TOOLCHAIN_EXTERNAL_BOOTLIN=y
# BR2_TOOLCHAIN_EXTERNAL_CUSTOM is not set
BR2_TOOLCHAIN_EXTERNAL_DOWNLOAD=y
# BR2_TOOLCHAIN_EXTERNAL_PREINSTALLED is not set
BR2_TOOLCHAIN_EXTERNAL_GLIBC=y
BR2_PACKAGE_HAS_TOOLCHAIN_EXTERNAL=y
BR2_PACKAGE_PROVIDES_TOOLCHAIN_EXTERNAL="toolchain-external-bootlin"
BR2_TOOLCHAIN_EXTERNAL_PREFIX="$(ARCH)-linux"
BR2_TOOLCHAIN_EXTERNAL_BOOTLIN_ARCH_SUPPORTS=y
# BR2_TOOLCHAIN_EXTERNAL_BOOTLIN_AARCH64_GLIBC_BLEEDING_EDGE is not set
BR2_TOOLCHAIN_EXTERNAL_BOOTLIN_AARCH64_GLIBC_STABLE=y
# BR2_TOOLCHAIN_EXTERNAL_BOOTLIN_AARCH64_MUSL_BLEEDING_EDGE is not set
# BR2_TOOLCHAIN_EXTERNAL_BOOTLIN_AARCH64_MUSL_STABLE is not set
# BR2_TOOLCHAIN_EXTERNAL_BOOTLIN_AARCH64_UCLIBC_BLEEDING_EDGE is not set
# BR2_TOOLCHAIN_EXTERNAL_BOOTLIN_AARCH64_UCLIBC_STABLE is not set
# BR2_TOOLCHAIN_EXTERNAL_GDB_SERVER_COPY is not set
BR2_PACKAGE_HOST_GDB_ARCH_SUPPORTS=y

BR2_TARGET_ROOTFS_EXT2=y
BR2_TARGET_ROOTFS_EXT2_4=y
BR2_TARGET_ROOTFS_SQUASHFS=y
BR2_PACKAGE_HOST_DOSFSTOOLS=y
BR2_PACKAGE_HOST_ENVIRONMENT_SETUP=y
BR2_PACKAGE_HOST_GENIMAGE=y
BR2_PACKAGE_HOST_MTOOLS=y
BR2_PACKAGE_HOST_RASPBERRYPI_USBBOOT=y
BR2_PACKAGE_HOST_RAUC=y
BR2_PACKAGE_LVM2_STANDARD_INSTALL=y
BR2_PACKAGE_HOST_UBOOT_TOOLS=y
BR2_PACKAGE_HOST_UBOOT_TOOLS_ENVIMAGE=y
BR2_PACKAGE_HOST_UBOOT_TOOLS_ENVIMAGE_SIZE="0x8000"
BR2_PACKAGE_HOST_UBOOT_TOOLS_ENVIMAGE_REDUNDANT=y
BR2_PACKAGE_HOST_UBOOT_TOOLS_BOOT_SCRIPT=y
BR2_PACKAGE_HOST_UBOOT_TOOLS_BOOT_SCRIPT_SOURCE="$(BR2_EXTERNAL_BR2RAUC_PATH)/board/coral/u-boot_coral.ush"
BR2_TARGET_UBOOT_NEEDS_PYLIBFDT=y

BR2_PACKAGE_SUDO=y
BR2_ROOTFS_USERS_TABLES="$(BR2_EXTERNAL_BR2RAUC_PATH)/board/coral/users"

BR2_PACKAGE_STRACE=y
BR2_ROOTFS_DEVICE_CREATION_DYNAMIC_MDEV=y
BR2_PACKAGE_NANO=y
# BR2_PACKAGE_NANO_TINY is not set
BR2_PACKAGE_GIT=y
BR2_PACKAGE_GREP=y
#BR2_PACKAGE_OPENSSH=y
#BR2_PACKAGE_OPENSSH_CLIENT=y
#BR2_PACKAGE_OPENSSH_SERVER=y
#BR2_PACKAGE_OPENSSH_KEY_UTILS=y
BR2_PACKAGE_DROPBEAR=y
BR2_PACKAGE_DROPBEAR_CLIENT=y
# BR2_PACKAGE_DROPBEAR_DISABLE_REVERSEDNS is not set
BR2_PACKAGE_DROPBEAR_SMALL=y
# BR2_PACKAGE_DROPBEAR_WTMP is not set
# BR2_PACKAGE_DROPBEAR_LASTLOG is not set
# BR2_PACKAGE_DROPBEAR_LEGACY_CRYPTO is not set
BR2_PACKAGE_DROPBEAR_LOCALOPTIONS_FILE=""
BR2_PACKAGE_STRESS_NG=y
BR2_PACKAGE_DCRON=y
BR2_PACKAGE_LIBQMI=y
BR2_PACKAGE_LIBGLIB2=y
BR2_PACKAGE_MINICOM=y
BR2_PACKAGE_TIO=y
BR2_PACKAGE_READLINE=y
BR2_PACKAGE_BASH=y
BR2_SYSTEM_BIN_SH_BASH=y
BR2_PACKAGE_RSYNC=y
BR2_PACKAGE_LIBCURL_CURL=y
BR2_PACKAGE_CA_CERTIFICATES=y
BR2_PACKAGE_PARTED=y
BR2_PACKAGE_E2FSPROGS=y
BR2_PACKAGE_E2FSPROGS_RESIZE2FS=y
BR2_PACKAGE_UTIL_LINUX_BINARIES=y
BR2_PACKAGE_IW=y
BR2_PACKAGE_PSMISC=y
BR2_PACKAGE_DTC=y
BR2_PACKAGE_DTC_PROGRAMS=y
BR2_PACKAGE_GZIP=y
BR2_PACKAGE_NETCAT=y
BR2_PACKAGE_NMAP=y
BR2_PACKAGE_SYSTEMD_LOGIND=y
BR2_PACKAGE_EXFAT=y
BR2_PACKAGE_LIBNICE=y
BR2_PACKAGE_HTOP=y
BR2_PACKAGE_GAWK=y
BR2_PACKAGE_TMUX=y
BR2_PACKAGE_SCREEN=y
BR2_PACKAGE_LM_SENSORS=y
BR2_PACKAGE_PERL=y
BR2_PACKAGE_LM_SENSORS_SENSORS_DETECT=y
BR2_PACKAGE_LFTP=y
#BR2_PACKAGE_IOSTAT=y
BR2_PACKAGE_IOTOP=y
BR2_PACKAGE_GDB=y
BR2_PACKAGE_GDB_DEBUGGER=y
BR2_PACKAGE_GDB_PYTHON=y
BR2_PACKAGE_MEMTESTER=y
BR2_PACKAGE_MEMTOOL=y
BR2_PACKAGE_NETDATA=y
BR2_PACKAGE_PV=y
BR2_PACKAGE_AUDIT=y
BR2_PACKAGE_VALGRIND=y

BR2_PACKAGE_GCC_FINAL=y

BR2_PACKAGE_SND_I2S_RPI=y
BR2_PACKAGE_AUDIO_CAPTURE=y


BR2_PACKAGE_ALSA_UTILS=y
BR2_PACKAGE_ALSA_UTILS=y
BR2_PACKAGE_ALSA_UTILS_ALSACONF=y
BR2_PACKAGE_ALSA_UTILS_ACONNECT=y
BR2_PACKAGE_ALSA_UTILS_ALSACTL=y
BR2_PACKAGE_ALSA_UTILS_ALSALOOP=y
BR2_PACKAGE_ALSA_UTILS_ALSAMIXER=y
BR2_PACKAGE_ALSA_UTILS_ALSAUCM=y
BR2_PACKAGE_ALSA_UTILS_ALSATPLG=y
# BR2_PACKAGE_ALSA_UTILS_AMIDI is not set
BR2_PACKAGE_ALSA_UTILS_AMIXER=y
BR2_PACKAGE_ALSA_UTILS_APLAY=y
# BR2_PACKAGE_ALSA_UTILS_APLAYMIDI is not set
# BR2_PACKAGE_ALSA_UTILS_ARECORDMIDI is not se
BR2_PACKAGE_ALSA_UTILS_ASEQDUMP=y
BR2_PACKAGE_ALSA_UTILS_ASEQNET=y
BR2_PACKAGE_ALSA_UTILS_BAT=y
BR2_PACKAGE_ALSA_UTILS_IECSET=y
BR2_PACKAGE_ALSA_UTILS_SPEAKER_TEST=y
BR2_PACKAGE_ALSA_LIB=y
BR2_PACKAGE_ALSA_LIB_PYTHON=y
BR2_PACKAGE_ALSA_LIB_DEVDIR="/dev/snd"
BR2_PACKAGE_ALSA_LIB_PCM_PLUGINS="all"
BR2_PACKAGE_ALSA_LIB_CTL_PLUGINS="all"
BR2_PACKAGE_ALSA_LIB_ALOAD=y
BR2_PACKAGE_ALSA_LIB_MIXER=y
BR2_PACKAGE_ALSA_LIB_PCM=y
# BR2_PACKAGE_ALSA_LIB_RAWMIDI is not set
BR2_PACKAGE_ALSA_LIB_HWDEP=y
BR2_PACKAGE_ALSA_LIB_SEQ=y
BR2_PACKAGE_ALSA_LIB_UCM=y
# BR2_PACKAGE_ALSA_LIB_ALISP is not set
BR2_PACKAGE_ALSA_LIB_OLD_SYMBOLS=y
#BR2_PACKAGE_ALSA_PLUGINS=y
BR2_PACKAGE_SOX=y
BR2_PACKAGE_PYTHON_ALSAAUDIO=y
BR2_PACKAGE_FFMPEG=y
BR2_PACKAGE_FFMPEG_FFPLAY=y
BR2_PACKAGE_LAME=y
BR2_PACKAGE_LIBSNDFILE=y

BR2_PACKAGE_BRIDGE_UTILS=y
BR2_PACKAGE_WIRESHARK=n
BR2_PACKAGE_IPTABLES=y
BR2_PACKAGE_IFTOP=y
#BR2_PACKAGE_DHCP=y
BR2_PACKAGE_DHCPCD=y
BR2_PACKAGE_DNSMASQ=y
BR2_PACKAGE_OPENVPN=y
BR2_PACKAGE_SYSTEMD_RESOLVED=n
BR2_PACKAGE_ARP_SCAN=y
BR2_PACKAGE_IFMETRIC=y

BR2_PACKAGE_PYTHON3=y
BR2_PACKAGE_PYTHON3_PY_ONLY=y
BR2_PACKAGE_PYTHON3_UNICODEDATA=y
BR2_PACKAGE_PYTHON_PAHO_MQTT=y
BR2_PACKAGE_PYTHON_PERIPHERY=y
BR2_PACKAGE_PYTHON3_ZLIB=y
BR2_PACKAGE_PYTHON_PIP=y
BR2_PACKAGE_PYTHON_PYSNMP=y
BR2_PACKAGE_PYTHON_PYSNMP_MIBS=y
BR2_PACKAGE_SNMPCLITOOLS=y
BR2_PACKAGE_PYTHON_FILELOCK=y
```

## i2s_mic/package/audio_capture/Config.in
```kconfig
config BR2_PACKAGE_AUDIO_CAPTURE
	bool "audio_capture"
	depends on BR2_TOOLCHAIN_HAS_THREADS
    select BR2_PACKAGE_ALSA_LIB
	help
	  Install basic audio capturing with C
```

## i2s_mic/package/snd_i2s_rpi/Config.in
```kconfig
config BR2_PACKAGE_SND_I2S_RPI
	bool "snd_i2s_rpi"
	help
	  Install snd_i2s_rpi i2s mic driver.
```
